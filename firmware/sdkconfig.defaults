## firmware/sdkconfig.defaults
```kconfig
CONFIG_IDF_TARGET="esp32s3"

# Board: ESP32-S3 DevKit N16R8 (16MB Flash + 8MB Octal PSRAM)
CONFIG_ESPTOOLPY_FLASHSIZE_16MB=y
CONFIG_ESPTOOLPY_FLASHMODE_QIO=y
CONFIG_SPIRAM=y
CONFIG_SPIRAM_MODE_OCT=y
CONFIG_SPIRAM_SPEED_80M=y
CONFIG_SPIRAM_USE_MALLOC=y

# Partition + OTA rollback (INTERFACE.md)
CONFIG_PARTITION_TABLE_CUSTOM=y
CONFIG_PARTITION_TABLE_CUSTOM_FILENAME="partitions.csv"
CONFIG_PARTITION_TABLE_OFFSET=0x8000
CONFIG_BOOTLOADER_APP_ROLLBACK_ENABLE=y

# USB-Serial-JTAG console (dual Type-C DevKit)
CONFIG_ESP_CONSOLE_USB_SERIAL_JTAG=y
CONFIG_ESP_CONSOLE_UART_DEFAULT=n

# FreeRTOS
CONFIG_FREERTOS_HZ=1000

# SoftAP provisioning / bring-up portal
CONFIG_ESP_WIFI_SOFTAP_SUPPORT=y
CONFIG_LWIP_IPV4=y

# MQTT + SNTP (M2 cloud skeleton)
CONFIG_MQTT_PROTOCOL_311=y
CONFIG_MBEDTLS_CERTIFICATE_BUNDLE=y
CONFIG_LWIP_SNTP_MAX_SERVERS=4
```
