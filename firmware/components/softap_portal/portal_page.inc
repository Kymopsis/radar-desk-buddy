/* Auto-generated from portal_page.html — do not edit by hand. */
static const char PAGE_HTML[] =
    "<!DOCTYPE html>\n"
    "<html lang=\"en\">\n"
    "<head>\n"
    "<meta charset=\"utf-8\">\n"
    "<meta name=\"viewport\" content=\"width=device-width,initial-scale=1\">\n"
    "<meta http-equiv=\"Cache-Control\" content=\"no-store\">\n"
    "<title>Desk Buddy Setup</title>\n"
    "<style>\n"
    ":root{--bg:#fbf0f4;--card:#fff;--ink:#1c1c1c;--muted:#666;--line:#e6e0e4;--accent:#c45b86;--accent2:#b85c38;--ok:#1f8a5b;--bad:#b33a3a;--warn:#c4872a}\n"
    "body.theme-f{--bg:#fbf0f4;--accent:#c45b86}\n"
    "body.theme-m{--bg:#eef4fb;--accent:#3a7ebd}\n"
    "*{box-sizing:border-box}\n"
    "body{font-family:system-ui,-apple-system,sans-serif;margin:0;background:var(--bg);color:var(--ink);transition:background .2s}\n"
    ".wrap{max-width:520px;margin:0 auto;padding:18px 16px 40px}\n"
    "h1{font-size:1.35rem;margin:0 0 6px}h2{font-size:1.05rem;margin:0 0 8px}\n"
    "h3{font-size:1rem;margin:18px 0 8px}\n"
    "p{line-height:1.45}.muted{color:var(--muted);font-size:.92rem}\n"
    ".card{background:var(--card);border-radius:14px;padding:16px;margin:12px 0;box-shadow:0 1px 0 rgba(0,0,0,.06)}\n"
    ".row{display:flex;flex-wrap:wrap;gap:8px;margin:8px 0}\n"
    "button{padding:12px 14px;font-size:1rem;border-radius:10px;border:1px solid #bbb;background:#fff;cursor:pointer}\n"
    "button.primary{background:var(--accent);color:#fff;border-color:var(--accent)}\n"
    "button.warn{background:var(--accent2);color:#fff;border-color:var(--accent2)}\n"
    "button.danger{background:#8b2e2e;color:#fff;border-color:#8b2e2e}\n"
    "button:disabled{opacity:.45}\n"
    "label{display:block;margin:8px 0 4px;font-weight:600}\n"
    "input,select{width:100%;padding:12px;font-size:1rem;border:1px solid var(--line);border-radius:10px;background:#fff}\n"
    ".badge{display:inline-block;padding:4px 10px;border-radius:999px;font-size:.9rem;background:#e8e0d4;font-weight:600}\n"
    ".badge.on{background:#c8eadf;color:#146047}.badge.off{background:#f0d6d0;color:#8a3030}\n"
    ".badge.wait{background:#ffe9c8;color:#8a5a10}.badge.ok{background:#c8eadf;color:#146047}.badge.bad{background:#f5d0d0;color:#8a3030}\n"
    ".swatch{display:flex;gap:10px}\n"
    ".swatch .opt{flex:1;border:2px solid var(--line);border-radius:12px;padding:14px;text-align:center;font-weight:600;cursor:pointer;user-select:none}\n"
    ".swatch .opt.f{background:linear-gradient(160deg,#ffe4ef,#fff)}\n"
    ".swatch .opt.m{background:linear-gradient(160deg,#dcecff,#fff)}\n"
    ".swatch .opt.on{border-color:var(--accent);box-shadow:0 0 0 3px rgba(196,91,134,.35)}\n"
    "body.theme-m .swatch .opt.on{box-shadow:0 0 0 3px rgba(58,126,189,.35)}\n"
    ".hidden{display:none!important}\n"
    "#wifiBanner,#cloudBanner,.banner{margin-top:12px;padding:12px 14px;border-radius:12px;font-weight:600;display:none}\n"
    "#wifiBanner.show,#cloudBanner.show,.banner.show{display:block}\n"
    "#wifiBanner.wait,#cloudBanner.wait,.banner.wait{background:#fff4df;color:#8a5a10}\n"
    "#wifiBanner.ok,#cloudBanner.ok,.banner.ok{background:#e5f7ee;color:#146047}\n"
    "#wifiBanner.bad,#cloudBanner.bad,.banner.bad{background:#fdeeee;color:#8a3030}\n"
    ".stat-grid{display:grid;gap:10px}\n"
    ".stat{display:flex;align-items:center;gap:12px;padding:12px;border:1px solid var(--line);border-radius:12px;background:#fcfafb}\n"
    ".stat .ico{width:40px;height:40px;border-radius:12px;display:flex;align-items:center;justify-content:center;font-size:1.1rem;background:#f3eef1;flex-shrink:0}\n"
    ".stat .meta{flex:1;min-width:0}\n"
    ".stat .k{font-size:.78rem;color:var(--muted);font-weight:600;letter-spacing:.02em}\n"
    ".stat .v{font-size:1rem;font-weight:650;margin-top:2px;word-break:break-word}\n"
    ".bars{display:inline-flex;gap:2px;align-items:flex-end;height:14px;margin-left:6px;vertical-align:middle}\n"
    ".bars i{display:block;width:4px;background:#ccc;border-radius:1px}\n"
    ".bars i.on{background:var(--ok)}\n"
    ".tune-grid{display:grid;grid-template-columns:1fr 1fr;gap:8px 12px}\n"
    "#tuneBanner{margin-top:12px;padding:12px 14px;border-radius:12px;font-weight:600;display:none}\n"
    "#tuneBanner.show{display:block}\n"
    "#tuneBanner.wait{background:#fff4df;color:#8a5a10}\n"
    "#tuneBanner.ok{background:#e5f7ee;color:#146047}\n"
    "#tuneBanner.bad{background:#fdeeee;color:#8a3030}\n"
    "</style>\n"
    "</head>\n"
    "<body class=\"theme-f\">\n"
    "<div class=\"wrap\">\n"
    "<section id=\"welcome\">\n"
    "<div class=\"card\">\n"
    "<h1 id=\"wTitle\">Desk Buddy</h1>\n"
    "<p class=\"muted\" id=\"wLead\">Choose language and color — updates the screen live.</p>\n"
    "<label id=\"lblLang\" for=\"langSel\">Language</label>\n"
    "<select id=\"langSel\">\n"
    "<option value=\"en\" selected>English</option>\n"
    "<option value=\"zh-CN\">简体中文</option>\n"
    "<option value=\"zh-TW\">繁體中文</option>\n"
    "<option value=\"ja\">日本語</option>\n"
    "<option value=\"ko\">한국어</option>\n"
    "<option value=\"es\">Español</option>\n"
    "<option value=\"fr\">Français</option>\n"
    "<option value=\"de\">Deutsch</option>\n"
    "<option value=\"pt\">Português</option>\n"
    "<option value=\"ru\">Русский</option>\n"
    "</select>\n"
    "<label id=\"lblTheme\" style=\"margin-top:14px\">Color theme</label>\n"
    "<div class=\"swatch\">\n"
    "<div class=\"opt f on\" id=\"optF\" data-gender=\"female\">Pink</div>\n"
    "<div class=\"opt m\" id=\"optM\" data-gender=\"male\">Blue</div>\n"
    "</div>\n"
    "<label id=\"lblFlip\" style=\"margin-top:14px\">Screen orientation</label>\n"
    "<div class=\"swatch\">\n"
    "<div class=\"opt on\" id=\"optFlip0\" data-flip=\"0\">Normal</div>\n"
    "<div class=\"opt\" id=\"optFlip1\" data-flip=\"1\">Flip 180°</div>\n"
    "</div>\n"
    "<p id=\"syncOk\"></p>\n"
    "<div class=\"row\"><button type=\"button\" class=\"primary\" id=\"btnEnter\" style=\"width:100%\">Continue</button></div>\n"
    "</div>\n"
    "</section>\n"
    "\n"
    "<section id=\"main\" class=\"hidden\">\n"
    "<h1 id=\"mTitle\">Desk Buddy Setup</h1>\n"
    "<p class=\"muted\" id=\"mLead\"></p>\n"
    "<p><button type=\"button\" id=\"btnPrefs\">Language / theme</button></p>\n"
    "\n"
    "<div class=\"card\">\n"
    "<h2 id=\"hWifi\">1. Wi-Fi</h2>\n"
    "<p class=\"muted\" id=\"pWifiHint\">Select a network, enter password, then Connect Wi-Fi.</p>\n"
    "<label id=\"lblSsid\" for=\"ssidList\">Network</label>\n"
    "<div class=\"row\">\n"
    "<select id=\"ssidList\" style=\"flex:1\"><option value=\"\">Scanning…</option></select>\n"
    "<button type=\"button\" id=\"btnScan\">Scan</button>\n"
    "</div>\n"
    "<label id=\"lblManual\" for=\"ssidManual\">Or type SSID</label>\n"
    "<input id=\"ssidManual\" placeholder=\"Optional manual SSID\">\n"
    "<label id=\"lblPass\" for=\"wifiPass\">Password</label>\n"
    "<input id=\"wifiPass\" type=\"password\" autocomplete=\"current-password\">\n"
    "<div class=\"row\"><button type=\"button\" class=\"primary\" id=\"btnWifi\" style=\"width:100%\">Connect Wi-Fi</button></div>\n"
    "<div id=\"wifiBanner\"></div>\n"
    "\n"
    "</div>\n"
    "\n"
    "<div class=\"card\">\n"
    "<h2 id=\"hPlace\">Time, weather &amp; Telegram</h2>\n"
    "<p class=\"muted\" id=\"pPlaceHint\">Type your city (name only, e.g. Berlin). Time zone and weather follow from it.</p>\n"
    "<label id=\"lblCity\" for=\"cityIn\">City</label>\n"
    "<input id=\"cityIn\" placeholder=\"Berlin\" autocomplete=\"off\" maxlength=\"48\">\n"
    "<div class=\"row\"><button type=\"button\" class=\"primary\" id=\"btnCity\" style=\"width:100%\">Save city</button></div>\n"
    "<div id=\"placeBanner\" class=\"banner\"></div>\n"
    "<h3 id=\"hTg\">Telegram (optional)</h3>\n"
    "<p class=\"muted\" id=\"pTgHint\">Create a bot with @BotFather, paste its token here, then open the bot and press Start. Messages you send it appear on the screen.</p>\n"
    "<label id=\"lblTg\" for=\"tgToken\">Bot token</label>\n"
    "<input id=\"tgToken\" type=\"password\" placeholder=\"123456789:AA...\" autocomplete=\"off\" maxlength=\"64\">\n"
    "<div class=\"row\">\n"
    "<button type=\"button\" class=\"primary\" id=\"btnTg\" style=\"flex:1\">Save token</button>\n"
    "<button type=\"button\" id=\"btnTgUnpair\">Unpair chat</button>\n"
    "</div>\n"
    "<div id=\"tgBanner\" class=\"banner\"></div>\n"
    "</div>\n"
    "<div class=\"card\">\n"
    "<h2 id=\"hFollow\">2. Radar</h2>\n"
    "<p id=\"pFollowState\"><span id=\"fbadge\" class=\"badge off\">Off</span></p>\n"
    "<canvas id=\"radarFan\" width=\"320\" height=\"200\" style=\"width:100%;max-width:360px;height:auto;display:block;margin:8px auto;background:#1a1f2a;border-radius:12px\"></canvas>\n"
    "<p class=\"muted\" id=\"radarHint\" style=\"text-align:center;margin:4px 0 2px\"></p>\n"
    "<p class=\"muted\" id=\"radarRule\" style=\"text-align:center;margin:0 0 8px;font-size:.85rem\"></p>\n"
    "<div class=\"row\">\n"
    "<button type=\"button\" id=\"btnOn\" class=\"primary\">Start follow</button>\n"
    "<button type=\"button\" id=\"btnOff\" class=\"danger\">Stop follow</button>\n"
    "</div>\n"
    "<p class=\"muted\" id=\"pFollowHint\"></p>\n"
    "</div>\n"
    "\n"
    "<div class=\"card\">\n"
    "<h2 id=\"hTune\">3. Distance</h2>\n"
    "<p class=\"muted\" id=\"pTuneHint\">Near lights the info face. Far keeps eyes + toy. Nobody → hide.</p>\n"
    "<p class=\"muted\" id=\"pTuneLive\"></p>\n"
    "<div class=\"tune-grid\">\n"
    "<div><label id=\"lblNear\" for=\"nearM\">Near enter (m)</label><input id=\"nearM\" type=\"number\" step=\"0.05\" min=\"0.2\" max=\"2.5\"></div>\n"
    "<div><label id=\"lblNearExit\" for=\"nearExitM\">Near exit (m)</label><input id=\"nearExitM\" type=\"number\" step=\"0.05\" min=\"0.25\" max=\"3\"></div>\n"
    "<div><label id=\"lblFar\" for=\"farM\">Far max (m)</label><input id=\"farM\" type=\"number\" step=\"0.1\" min=\"1.5\" max=\"8\"></div>\n"
    "<div><label id=\"lblHide\" for=\"hideS\">Hide after (s)</label><input id=\"hideS\" type=\"number\" step=\"1\" min=\"3\" max=\"30\"></div>\n"
    "<div><label id=\"lblRise\" for=\"riseMs\">Rise delay (ms)</label><input id=\"riseMs\" type=\"number\" step=\"50\" min=\"100\" max=\"2000\"></div>\n"
    "<div><label id=\"lblPanDps\" for=\"panDps\">Pan speed (°/s)</label><input id=\"panDps\" type=\"number\" step=\"5\" min=\"20\" max=\"180\"></div>\n"
    "<div><label id=\"lblPanMax\" for=\"panMax\">Pan limit (±°)</label><input id=\"panMax\" type=\"number\" step=\"5\" min=\"30\" max=\"90\"></div>\n"
    "</div>\n"
    "<div class=\"row\"><button type=\"button\" class=\"primary\" id=\"btnTune\" style=\"width:100%\">Save distance</button></div>\n"
    "<div class=\"row\"><button type=\"button\" id=\"btnDefaults\" style=\"width:100%\">Restore defaults</button></div>\n"
    "<div id=\"tuneBanner\"></div>\n"
    "</div>\n"
    "\n"
    "<div class=\"card\">\n"
    "<h2 id=\"hStatus\">4. Live status</h2>\n"
    "<div class=\"stat-grid\" id=\"statGrid\">\n"
    "<div class=\"stat\"><div class=\"ico\">📡</div><div class=\"meta\"><div class=\"k\" id=\"kFollow\">Follow</div><div class=\"v\" id=\"vFollow\">—</div></div></div>\n"
    "<div class=\"stat\"><div class=\"ico\">👤</div><div class=\"meta\"><div class=\"k\" id=\"kPresent\">Presence</div><div class=\"v\" id=\"vPresent\">—</div></div></div>\n"
    "<div class=\"stat\"><div class=\"ico\">📐</div><div class=\"meta\"><div class=\"k\" id=\"kZone\">Zone</div><div class=\"v\" id=\"vZone\">—</div></div></div>\n"
    "<div class=\"stat\"><div class=\"ico\">📶</div><div class=\"meta\"><div class=\"k\" id=\"kHomeWifi\">Home Wi-Fi</div><div class=\"v\" id=\"vHomeWifi\">—</div></div></div>\n"
    "<div class=\"stat\"><div class=\"ico\">🎀</div><div class=\"meta\"><div class=\"k\" id=\"kTheme\">Theme</div><div class=\"v\" id=\"vTheme\">—</div></div></div>\n"
    "<div class=\"stat\"><div class=\"ico\">⛅</div><div class=\"meta\"><div class=\"k\" id=\"kPlace\">City</div><div class=\"v\" id=\"vPlace\">—</div></div></div>\n"
    "<div class=\"stat\"><div class=\"ico\">✈</div><div class=\"meta\"><div class=\"k\" id=\"kTg\">Telegram</div><div class=\"v\" id=\"vTg\">—</div></div></div>\n"
    "<div class=\"stat\"><div class=\"ico\">☁</div><div class=\"meta\"><div class=\"k\" id=\"kCloud\">Own server</div><div class=\"v\" id=\"vCloud\">—</div></div></div>\n"
    "</div>\n"
    "</div>\n"
    "\n"
    "<div class=\"card\">\n"
    "<h2 id=\"hCal\">5. Servo calibration</h2>\n"
    "<p class=\"muted\" id=\"pCalHint\">Optional. Jogging exits follow mode.</p>\n"
    "<h2 style=\"margin-top:8px;font-size:1rem\">Pan</h2>\n"
    "<div class=\"row\">\n"
    "<button type=\"button\" data-j=\"/servo?pan=-10\">-10°</button>\n"
    "<button type=\"button\" data-j=\"/servo?pan=-1\">-1°</button>\n"
    "<button type=\"button\" class=\"primary\" data-j=\"/servo?pan_set=0\">0°</button>\n"
    "<button type=\"button\" data-j=\"/servo?pan=1\">+1°</button>\n"
    "<button type=\"button\" data-j=\"/servo?pan=10\">+10°</button>\n"
    "</div>\n"
    "<h2 style=\"font-size:1rem\">Lift</h2>\n"
    "<div class=\"row\">\n"
    "<button type=\"button\" data-j=\"/servo?lift_set=0\">0%</button>\n"
    "<button type=\"button\" data-j=\"/servo?lift=-5\">-5%</button>\n"
    "<button type=\"button\" data-j=\"/servo?lift=5\">+5%</button>\n"
    "<button type=\"button\" data-j=\"/servo?lift_set=100\">100%</button>\n"
    "</div>\n"
    "<div class=\"row\">\n"
    "<button type=\"button\" class=\"warn\" id=\"btnHome\" data-j=\"/servo?home=1\">Safe home</button>\n"
    "<button type=\"button\" id=\"btnFlip\" data-j=\"/servo?flip_pan=1\">Flip pan</button>\n"
    "</div>\n"
    "</div>\n"
    "<details class=\"card\">\n"
    "<summary id=\"hCloudCard\" style=\"font-weight:650;cursor:pointer\">Advanced: your own server (Level 3)</summary>\n"
    "\n"
    "<p class=\"muted\" id=\"pCloudHint\">Pair code and cloud URL. Does not rejoin Wi-Fi.</p>\n"
    "<label id=\"lblBind\" for=\"bindCode\">Pair code</label>\n"
    "<input id=\"bindCode\" placeholder=\"my-pair-code\" autocomplete=\"off\" maxlength=\"32\">\n"
    "<label id=\"lblCloud\" for=\"claimBase\">Cloud URL</label>\n"
    "<input id=\"claimBase\" placeholder=\"https://buddy.example.com\" autocomplete=\"off\" maxlength=\"96\">\n"
    "<div class=\"row\"><button type=\"button\" class=\"primary\" id=\"btnCloud\" style=\"width:100%\">Connect server</button></div>\n"
    "<div id=\"cloudBanner\"></div>\n"
    "</details>\n"
    "</section>\n"
    "</div>\n"
    "<script>\n"
    "(function(){\n"
    "var T={\n"
    "en:{title:\"Desk Buddy\",lead:\"Choose language and color — updates the screen live.\",\n"
    "lang:\"Language\",theme:\"Color theme\",pink:\"Pink\",blue:\"Blue\",go:\"Continue\",synced:\"Synced to screen\",\n"
    "mTitle:\"Desk Buddy Setup\",mLead:\"Wi-Fi first, then your city, then radar and the rest.\",\n"
    "prefs:\"Language / theme\",hFollow:\"2. Radar\",fOn:\"On\",fOff:\"Off\",\n"
    "start:\"Start follow\",stop:\"Stop follow\",\n"
    "fHint:\"On at boot: screen eyes and toy track together. Stop follow here until the next power cycle — it is not remembered.\",\n"
    "radarEmpty:\"No target yet — face the radar forward.\",\n"
    "radarLive:\"Green = nearest (pan follows) · blue = others\",\n"
    "radarRule:\"Track nearest in-range target; pan limit from Distance. Scale rings to 6 m.\",\n"
    "hTune:\"3. Distance\",pTuneHint:\"Near shows time + weather (setup QR while offline). Far keeps eyes + toy. Nobody → hide.\",\n"
    "lblNear:\"Near enter (m)\",lblNearExit:\"Near exit (m)\",lblFar:\"Far max (m)\",\n"
    "lblHide:\"Hide after (s)\",lblRise:\"Rise delay (ms)\",lblPanDps:\"Pan speed (°/s)\",lblPanMax:\"Pan limit (±°)\",\n"
    "saveTune:\"Save distance\",resetTune:\"Restore defaults\",tuneOk:\"Saved — live now\",tuneFail:\"Could not save\",\n"
    "resetOk:\"Restored factory distance + follow ON\",resetFail:\"Could not restore\",\n"
    "zoneVoid:\"Empty (hidden)\",zoneFar:\"Far (eyes)\",zoneNear:\"Near (content)\",kZone:\"Zone\",\n"
    "hWifi:\"1. Wi-Fi\",wHint:\"Pick a network, enter password, then Connect Wi-Fi.\",\n"
    "net:\"Network\",scan:\"Scan\",manual:\"Or type SSID\",pass:\"Password\",bind:\"Pair code\",cloud:\"Cloud URL\",\n"
    "conn:\"Connect Wi-Fi\",connCloud:\"Connect server\",\n"
    "hCloudCard:\"Server\",cCloudHint:\"Pair code and cloud URL. Connecting the server will not rejoin Wi-Fi.\",\n"
    "scanning:\"Scanning…\",scanFail:\"Scan failed\",connecting:\"Connecting to Wi-Fi…\",\n"
    "connStart:\"Saved. Connecting Wi-Fi… SoftAP stays up.\",\n"
    "connOk:\"Connected\",connFail:\"Could not join Wi-Fi. Check password and try again.\",\n"
    "needSsid:\"Select or type a Wi-Fi name\",\n"
    "cloudStart:\"Saved. Connecting to the server…\",\n"
    "cloudOk:\"Server connected\",cloudFail:\"Could not reach the server. Check pair code and URL.\",\n"
    "cloudWaitIp:\"Waiting for home Wi-Fi…\",cloudSntp:\"Syncing time…\",\n"
    "cloudClaim:\"Claiming device…\",cloudMqtt:\"Connecting MQTT…\",\n"
    "cloudNeedWifi:\"Connect home Wi-Fi first.\",\n"
    "needBind:\"Enter a pair code\",\n"
    "flip:\"Screen orientation\",flip0:\"Normal\",flip1:\"Flip 180°\",\n"
    "wifiDown:\"Not connected\",wifiWait:\"Connecting…\",\n"
    "presentYes:\"Someone nearby\",presentNo:\"No one nearby\",\n"
    "kFollow:\"Radar follow\",kPresent:\"Presence\",kHomeWifi:\"Home Wi-Fi\",kTheme:\"Theme\",kCloud:\"Cloud\",\n"
    "hStatus:\"4. Live status\",hCal:\"5. Servo calibration\",cHint:\"Optional. Jogging exits follow.\",\n"
    "home:\"Safe home\",flipPan:\"Flip pan\",\n"
    "hPlace:\"Time, weather & Telegram\",pPlaceHint:\"Type your city (name only, e.g. Berlin). Time zone and weather follow from it.\",\n"
    "lblCity:\"City\",btnCity:\"Save city\",cityStart:\"Saved. Looking up the city…\",cityOk:\"Weather for\",cityNotFound:\"City not found. Try the English name, without country.\",\n"
    "cityNeedWifi:\"Saved. It is looked up once home Wi-Fi is connected.\",kPlace:\"City\",\n"
    "hTg:\"Telegram (optional)\",pTgHint:\"Create a bot with @BotFather, paste its token here, then open the bot and press Start. Messages you send it appear on the screen.\",\n"
    "lblTg:\"Bot token\",btnTg:\"Save token\",btnTgUnpair:\"Unpair chat\",kTg:\"Telegram\",\n"
    "tgOff:\"Off\",tgWaitWifi:\"Waiting for Wi-Fi…\",tgWaitPair:\"Open the bot and press Start:\",tgPaired:\"Paired\",tgBad:\"Token rejected. Copy it again from @BotFather.\",tgErr:\"Cannot reach Telegram right now.\",\n"
    "needUrl:\"Enter your server URL (http:// or https://)\",hCloudCard:\"Advanced: your own server (Level 3)\",kCloud:\"Own server\",\n"
    "cCloudHint:\"Only for the self-hosted server in the server/ folder. Leave empty for Levels 1 and 2.\"},\n"
    "\"zh-CN\":{title:\"Desk Buddy\",lead:\"选择语言和配色会立刻反映在设备屏幕上。\",\n"
    "lang:\"语言\",theme:\"配色\",pink:\"粉色\",blue:\"蓝色\",go:\"进入设置\",synced:\"已同步到屏幕\",\n"
    "mTitle:\"Desk Buddy 设置\",mLead:\"先配 Wi-Fi 和城市，再看雷达，然后是其他设置。\",\n"
    "prefs:\"语言 / 配色\",hFollow:\"2. 雷达\",fOn:\"开启\",fOff:\"关闭\",\n"
    "start:\"启动跟随\",stop:\"停止跟随\",\n"
    "fHint:\"上电默认开：屏幕眼睛和玩具一起跟随。点「停止跟随」只对这一次上电有效，断电后再开仍会跟随。\",\n"
    "radarEmpty:\"暂无目标 — 请正对雷达前方。\",\n"
    "radarLive:\"绿=最近（舵机跟随）· 蓝=其他目标\",\n"
    "radarRule:\"跟随扇形内最近目标；转角上限见距离设置。刻度环到 6 m。\",\n"
    "hTune:\"3. 距离\",pTuneHint:\"近场亮起内容（没联网则显示二维码，联网后显示时间天气）。远场眼睛+玩具跟随。无人则藏起。\",\n"
    "lblNear:\"近场进入 (m)\",lblNearExit:\"近场退出 (m)\",lblFar:\"远场上限 (m)\",\n"
    "lblHide:\"无人藏起 (秒)\",lblRise:\"升起确认 (ms)\",lblPanDps:\"转向速度 (°/s)\",lblPanMax:\"转向软限 (±°)\",\n"
    "saveTune:\"保存距离\",resetTune:\"恢复默认\",tuneOk:\"已保存，立即生效\",tuneFail:\"保存失败\",\n"
    "resetOk:\"已恢复出厂距离，并重新开启跟随\",resetFail:\"恢复失败\",\n"
    "zoneVoid:\"无人（关闭）\",zoneFar:\"远场（眼睛）\",zoneNear:\"近场（内容）\",kZone:\"距离带\",\n"
    "hWifi:\"1. Wi-Fi\",wHint:\"选择网络、填密码后连接 Wi-Fi。\",\n"
    "net:\"网络\",scan:\"扫描\",manual:\"或手输名称\",pass:\"密码\",bind:\"绑定码\",cloud:\"云地址\",\n"
    "conn:\"连接 Wi-Fi\",connCloud:\"连接服务器\",\n"
    "hCloudCard:\"服务器\",cCloudHint:\"填绑定码和云地址后连接服务器。不会重新连接 Wi-Fi。\",\n"
    "scanning:\"扫描中…\",scanFail:\"扫描失败\",connecting:\"正在连接 Wi-Fi…\",\n"
    "connStart:\"已保存，正在连接 Wi-Fi… 配网热点仍可用。\",\n"
    "connOk:\"已连接\",connFail:\"连接失败，请检查密码后重试。\",\n"
    "needSsid:\"请选择或输入 Wi-Fi 名称\",\n"
    "cloudStart:\"已保存绑定，正在连接服务器…\",\n"
    "cloudOk:\"服务器已连接\",cloudFail:\"服务器连接失败，请检查绑定码和云地址。\",\n"
    "cloudWaitIp:\"等待家里 Wi-Fi…\",cloudSntp:\"正在对时…\",\n"
    "cloudClaim:\"正在登记设备…\",cloudMqtt:\"正在连接 MQTT…\",\n"
    "cloudNeedWifi:\"请先连接家里 Wi-Fi。\",\n"
    "needBind:\"请填写绑定码\",\n"
    "flip:\"屏幕方向\",flip0:\"正向\",flip1:\"翻转 180°\",\n"
    "wifiDown:\"未连接\",wifiWait:\"连接中…\",\n"
    "presentYes:\"附近有人\",presentNo:\"附近无人\",\n"
    "kFollow:\"雷达跟随\",kPresent:\"人体感应\",kHomeWifi:\"家里 Wi-Fi\",kTheme:\"配色\",kCloud:\"云\",\n"
    "hStatus:\"4. 实时状态\",hCal:\"5. 舵机标定\",cHint:\"可选。点动会退出跟随。\",\n"
    "home:\"安全回中\",flipPan:\"翻转方向\",\n"
    "hPlace:\"时间、天气和 Telegram\",pPlaceHint:\"输入城市名（只写城市，例如 Shenzhen 或 深圳），时区和天气按城市自动获取。\",\n"
    "lblCity:\"城市\",btnCity:\"保存城市\",cityStart:\"已保存，正在查找城市…\",cityOk:\"天气地点：\",cityNotFound:\"找不到这个城市，请试试英文名，不要带国家。\",\n"
    "cityNeedWifi:\"已保存，连上家里 Wi-Fi 后自动查找。\",kPlace:\"城市\",\n"
    "hTg:\"Telegram（可选）\",pTgHint:\"在 @BotFather 创建机器人，把 token 粘贴到这里，然后打开机器人点 Start。发给它的文字会显示在屏幕上。\",\n"
    "lblTg:\"机器人 token\",btnTg:\"保存 token\",btnTgUnpair:\"解除绑定\",kTg:\"Telegram\",\n"
    "tgOff:\"未开启\",tgWaitWifi:\"等待 Wi-Fi…\",tgWaitPair:\"打开机器人点 Start：\",tgPaired:\"已绑定\",tgBad:\"token 无效，请从 @BotFather 重新复制。\",tgErr:\"暂时连不上 Telegram。\",\n"
    "needUrl:\"请输入服务器地址（http:// 或 https://）\",hCloudCard:\"进阶：自建服务器（第 3 级）\",kCloud:\"自建服务器\",\n"
    "cCloudHint:\"只用于 server/ 目录里的自建服务器。第 1、2 级不用填。\"},\n"
    "\"zh-TW\":{title:\"Desk Buddy\",lead:\"選擇語言與配色會立刻反映在裝置螢幕上。\",\n"
    "lang:\"語言\",theme:\"配色\",pink:\"粉色\",blue:\"藍色\",go:\"進入設定\",synced:\"已同步到螢幕\",\n"
    "mTitle:\"Desk Buddy 設定\",mLead:\"先配 Wi-Fi 與城市，再看雷達，然後是其他設定。\",\n"
    "prefs:\"語言 / 配色\",hFollow:\"2. 雷達\",fOn:\"開啟\",fOff:\"關閉\",\n"
    "start:\"啟動跟隨\",stop:\"停止跟隨\",\n"
    "fHint:\"上電預設開：螢幕眼睛與玩具一起跟隨。點「停止跟隨」只對這次上電有效，斷電後再開仍會跟隨。\",\n"
    "radarEmpty:\"暫無目標 — 請正對雷達前方。\",\n"
    "radarLive:\"綠=最近（跟隨）· 藍=其他\",\n"
    "radarRule:\"跟隨扇形內最近目標；轉角上限見距離設定。刻度到 6 m。\",\n"
    "hTune:\"3. 距離\",pTuneHint:\"近場亮起內容（沒連網則顯示二維碼，連網後顯示時間天氣）。遠場眼睛+玩具跟隨。無人則藏起。\",\n"
    "lblNear:\"近場進入 (m)\",lblNearExit:\"近場退出 (m)\",lblFar:\"遠場上限 (m)\",\n"
    "lblHide:\"無人藏起 (秒)\",lblRise:\"升起確認 (ms)\",lblPanDps:\"轉向速度 (°/s)\",lblPanMax:\"轉向軟限 (±°)\",\n"
    "saveTune:\"儲存距離\",resetTune:\"恢復預設\",tuneOk:\"已儲存，立刻生效\",tuneFail:\"儲存失敗\",\n"
    "resetOk:\"已恢復出廠距離，並重新開啟跟隨\",resetFail:\"恢復失敗\",\n"
    "zoneVoid:\"無人（關閉）\",zoneFar:\"遠場（眼睛）\",zoneNear:\"近場（內容）\",kZone:\"距離帶\",\n"
    "hWifi:\"1. Wi-Fi\",wHint:\"選擇網路、填密碼後連接 Wi-Fi。\",\n"
    "net:\"網路\",scan:\"掃描\",manual:\"或手輸名稱\",pass:\"密碼\",bind:\"綁定碼\",cloud:\"雲端位址\",\n"
    "conn:\"連接 Wi-Fi\",connCloud:\"連接伺服器\",\n"
    "hCloudCard:\"伺服器\",cCloudHint:\"填綁定碼與雲端位址後連接伺服器。不會重新連接 Wi-Fi。\",\n"
    "scanning:\"掃描中…\",scanFail:\"掃描失敗\",connecting:\"正在連線…\",\n"
    "connStart:\"已儲存，正在連線 Wi-Fi…\",\n"
    "connOk:\"已連線\",connFail:\"連線失敗，請檢查密碼。\",\n"
    "needSsid:\"請選擇或輸入名稱\",\n"
    "cloudStart:\"已儲存綁定，正在連接伺服器…\",\n"
    "cloudOk:\"伺服器已連線\",cloudFail:\"伺服器連線失敗，請檢查綁定碼與位址。\",\n"
    "cloudWaitIp:\"等待家里 Wi-Fi…\",cloudSntp:\"正在對時…\",\n"
    "cloudClaim:\"正在登記裝置…\",cloudMqtt:\"正在連接 MQTT…\",\n"
    "cloudNeedWifi:\"請先連接家里 Wi-Fi。\",\n"
    "needBind:\"請填寫綁定碼\",\n"
    "flip:\"螢幕方向\",flip0:\"正向\",flip1:\"翻轉 180°\",\n"
    "wifiDown:\"未連線\",wifiWait:\"連線中…\",\n"
    "presentYes:\"附近有人\",presentNo:\"附近無人\",\n"
    "kFollow:\"雷達跟隨\",kPresent:\"人體感應\",kHomeWifi:\"家里 Wi-Fi\",kTheme:\"配色\",kCloud:\"雲\",\n"
    "hStatus:\"4. 即時狀態\",hCal:\"5. 舵機標定\",cHint:\"可選。點動會退出跟隨。\",\n"
    "home:\"安全回中\",flipPan:\"翻轉方向\"},\n"
    "ja:{title:\"Desk Buddy\",lead:\"言語と色を選ぶと画面にすぐ反映されます。\",\n"
    "lang:\"言語\",theme:\"テーマ\",pink:\"ピンク\",blue:\"ブルー\",go:\"続行\",synced:\"画面に同期済み\",\n"
    "mTitle:\"Desk Buddy 設定\",mLead:\"先に Wi-Fi とサーバー、次にレーダー、その他は後で。\",\n"
    "prefs:\"言語 / テーマ\",hFollow:\"2. レーダー\",fOn:\"ON\",fOff:\"OFF\",\n"
    "start:\"追従開始\",stop:\"追従停止\",fHint:\"起動時はON：目とフィギュアが一緒に追従。停止はこの通電中だけ。電源を入れ直すと再び追従します。\",\n"
    "radarEmpty:\"目標なし — 正面を向けてください。\",\n"
    "radarLive:\"緑=最近（追従）· 青=他目標\",\n"
    "radarRule:\"扇形内の最近目標を追従。角度上限は距離設定。目盛は 6 m。\",\n"
    "hTune:\"3. 距離\",pTuneHint:\"近場で内容（オフライン時はQR）。遠場は目+追従。不在は収納。\",\n"
    "lblNear:\"近場入り (m)\",lblNearExit:\"近場抜け (m)\",lblFar:\"遠場上限 (m)\",\n"
    "lblHide:\"収納まで (秒)\",lblRise:\"上昇確認 (ms)\",lblPanDps:\"旋回速度 (°/s)\",lblPanMax:\"旋回上限 (±°)\",\n"
    "saveTune:\"距離を保存\",resetTune:\"初期値に戻す\",tuneOk:\"保存して即反映\",tuneFail:\"保存失敗\",\n"
    "resetOk:\"距離を初期化し、追従をONにしました\",resetFail:\"復元失敗\",\n"
    "zoneVoid:\"不在（消灯）\",zoneFar:\"遠場（目）\",zoneNear:\"近場（内容）\",kZone:\"ゾーン\",\n"
    "hWifi:\"1. Wi-Fi\",wHint:\"ネットワークとパスワードを入力して接続。\",\n"
    "net:\"ネットワーク\",scan:\"スキャン\",manual:\"SSIDを入力\",pass:\"パスワード\",bind:\"ペアコード\",cloud:\"クラウドURL\",\n"
    "conn:\"Wi-Fi接続\",connCloud:\"サーバー接続\",\n"
    "hCloudCard:\"サーバー\",cCloudHint:\"ペアコードとURL。サーバー接続はWi-Fiを繋ぎ直しません。\",\n"
    "scanning:\"スキャン中…\",scanFail:\"失敗\",connecting:\"接続中…\",\n"
    "connStart:\"保存してWi-Fi接続中…\",connOk:\"接続完了\",connFail:\"接続失敗。パスワードを確認。\",\n"
    "needSsid:\"SSIDを選んでください\",\n"
    "cloudStart:\"保存してサーバー接続中…\",\n"
    "cloudOk:\"サーバー接続完了\",cloudFail:\"サーバー接続失敗。コードとURLを確認。\",\n"
    "cloudWaitIp:\"自宅Wi-Fi待ち…\",cloudSntp:\"時刻同期中…\",\n"
    "cloudClaim:\"デバイス登録中…\",cloudMqtt:\"MQTT接続中…\",\n"
    "cloudNeedWifi:\"先に自宅Wi-Fiへ接続してください。\",\n"
    "needBind:\"ペアコードを入力\",\n"
    "flip:\"画面の向き\",flip0:\"通常\",flip1:\"180°反転\",\n"
    "wifiDown:\"未接続\",wifiWait:\"接続中…\",\n"
    "presentYes:\"近くに人あり\",presentNo:\"近くに人なし\",\n"
    "kFollow:\"レーダー追従\",kPresent:\"在席\",kHomeWifi:\"自宅Wi-Fi\",kTheme:\"テーマ\",kCloud:\"クラウド\",\n"
    "hStatus:\"4. 状態\",hCal:\"5. サーボ調整\",cHint:\"任意。操作すると追従解除。\",\n"
    "home:\"安全ホーム\",flipPan:\"向き反転\"}\n"
    "};\n"
    "var gender=\"female\";\n"
    "var screenFlip=false;\n"
    "var lastSta=\"idle\";\n"
    "var prefsHydrated=false;\n"
    "var cloudHydrated=false;\n"
    "var tuneHydrated=false;\n"
    "var scanning=false;\n"
    "var wifiBusy=false;\n"
    "var cloudBusy=false;\n"
    "var scanTimer=null;\n"
    "function el(id){return document.getElementById(id);}\n"
    "function tr(){var l=el(\"langSel\").value;return T[l]||T.en;}\n"
    "function lsGet(k){try{return localStorage.getItem(k);}catch(e){return null;}}\n"
    "function lsSet(k,v){try{localStorage.setItem(k,v);}catch(e){}}\n"
    "function lsDel(k){try{localStorage.removeItem(k);}catch(e){}}\n"
    "function applyTheme(){\n"
    "document.body.className=gender===\"male\"?\"theme-m\":\"theme-f\";\n"
    "el(\"optF\").className=\"opt f\"+(gender===\"female\"?\" on\":\"\");\n"
    "el(\"optM\").className=\"opt m\"+(gender===\"male\"?\" on\":\"\");\n"
    "el(\"optF\").textContent=tr().pink;\n"
    "el(\"optM\").textContent=tr().blue;\n"
    "el(\"optFlip0\").className=\"opt\"+(screenFlip?\"\":\" on\");\n"
    "el(\"optFlip1\").className=\"opt\"+(screenFlip?\" on\":\"\");\n"
    "el(\"optFlip0\").textContent=tr().flip0;\n"
    "el(\"optFlip1\").textContent=tr().flip1;\n"
    "}\n"
    "function applyI18n(){\n"
    "var t=tr();\n"
    "function set(id,v){var e=el(id);if(e)e.textContent=v;}\n"
    "set(\"wTitle\",t.title);set(\"wLead\",t.lead);set(\"lblLang\",t.lang);\n"
    "set(\"lblTheme\",t.theme);set(\"lblFlip\",t.flip);set(\"btnEnter\",t.go);\n"
    "set(\"mTitle\",t.mTitle);set(\"mLead\",t.mLead);set(\"btnPrefs\",t.prefs);\n"
    "set(\"hFollow\",t.hFollow);set(\"btnOn\",t.start);set(\"btnOff\",t.stop);set(\"pFollowHint\",t.fHint);\n"
    "set(\"hTune\",t.hTune||T.en.hTune);set(\"pTuneHint\",t.pTuneHint||T.en.pTuneHint);\n"
    "set(\"lblNear\",t.lblNear||T.en.lblNear);set(\"lblNearExit\",t.lblNearExit||T.en.lblNearExit);\n"
    "set(\"lblFar\",t.lblFar||T.en.lblFar);set(\"lblHide\",t.lblHide||T.en.lblHide);\n"
    "set(\"lblRise\",t.lblRise||T.en.lblRise);set(\"lblPanDps\",t.lblPanDps||T.en.lblPanDps);\n"
    "set(\"lblPanMax\",t.lblPanMax||T.en.lblPanMax);set(\"btnTune\",t.saveTune||T.en.saveTune);\n"
    "set(\"btnDefaults\",t.resetTune||T.en.resetTune);\n"
    "set(\"hWifi\",t.hWifi);set(\"pWifiHint\",t.wHint);set(\"lblSsid\",t.net);\n"
    "set(\"btnScan\",t.scan);set(\"lblManual\",t.manual);set(\"lblPass\",t.pass);set(\"btnWifi\",t.conn);\n"
    "set(\"hCloudCard\",t.hCloudCard||T.en.hCloudCard);set(\"pCloudHint\",t.cCloudHint||T.en.cCloudHint);\n"
    "set(\"lblBind\",t.bind||\"Pair code\");set(\"lblCloud\",t.cloud||\"Cloud URL\");set(\"btnCloud\",t.connCloud||\"Connect server\");\n"
    "set(\"hCal\",t.hCal);set(\"pCalHint\",t.cHint);set(\"btnHome\",t.home);set(\"btnFlip\",t.flipPan);set(\"hStatus\",t.hStatus);\n"
    "set(\"kFollow\",t.kFollow);set(\"kPresent\",t.kPresent);set(\"kHomeWifi\",t.kHomeWifi);set(\"kTheme\",t.kTheme);\n"
    "set(\"kCloud\",t.kCloud||T.en.kCloud);\n"
    "[\"hPlace\",\"pPlaceHint\",\"lblCity\",\"btnCity\",\"kPlace\",\"hTg\",\"pTgHint\",\"lblTg\",\"btnTg\",\"btnTgUnpair\",\"kTg\"].forEach(function(k){set(k,t[k]||T.en[k]);});set(\"kZone\",t.kZone||T.en.kZone);\n"
    "document.documentElement.lang=el(\"langSel\").value;\n"
    "applyTheme();\n"
    "}\n"
    "function pushPrefs(done){\n"
    "var langVal=el(\"langSel\").value;\n"
    "var body=\"lang=\"+encodeURIComponent(langVal)+\"&gender=\"+encodeURIComponent(gender)+\"&flip=\"+(screenFlip?\"1\":\"0\");\n"
    "var x=new XMLHttpRequest();\n"
    "x.open(\"POST\",\"/api/prefs\",true);x.timeout=2500;\n"
    "x.setRequestHeader(\"Content-Type\",\"application/x-www-form-urlencoded\");\n"
    "x.onload=function(){var ok=x.status>=200&&x.status<300;var tip=el(\"syncOk\");if(tip)tip.textContent=ok?tr().synced:(\"prefs \"+x.status);if(done)done(ok);};\n"
    "x.onerror=function(){if(done)done(false);};x.ontimeout=function(){if(done)done(false);};\n"
    "try{x.send(body);}catch(e){if(done)done(false);}\n"
    "}\n"
    "function showMain(){el(\"welcome\").classList.add(\"hidden\");el(\"main\").classList.remove(\"hidden\");applyI18n();scanWifi({force:true});startAutoScan();}\n"
    "function showWelcome(){el(\"main\").classList.add(\"hidden\");el(\"welcome\").classList.remove(\"hidden\");applyI18n();}\n"
    "function onPrefsChanged(){applyI18n();pushPrefs(null);}\n"
    "el(\"btnEnter\").onclick=function(){applyI18n();lsSet(\"pet_setup\",\"1\");showMain();pushPrefs(null);};\n"
    "el(\"btnPrefs\").onclick=function(){lsDel(\"pet_setup\");showWelcome();};\n"
    "el(\"langSel\").onchange=onPrefsChanged;\n"
    "el(\"optF\").onclick=function(){gender=\"female\";onPrefsChanged();};\n"
    "el(\"optM\").onclick=function(){gender=\"male\";onPrefsChanged();};\n"
    "el(\"optFlip0\").onclick=function(){screenFlip=false;onPrefsChanged();};\n"
    "el(\"optFlip1\").onclick=function(){screenFlip=true;onPrefsChanged();};\n"
    "\n"
    "function rssiBars(rssi){\n"
    "var n=0;\n"
    "if(rssi>=-55)n=4;else if(rssi>=-65)n=3;else if(rssi>=-75)n=2;else if(rssi>=-85)n=1;\n"
    "var h=[4,7,10,13],html='<span class=\"bars\">';\n"
    "for(var i=0;i<4;i++)html+='<i class=\"'+(i<n?'on':'')+'\" style=\"height:'+h[i]+'px\"></i>';\n"
    "return html+'</span>';\n"
    "}\n"
    "function setBanner(kind,text){\n"
    "var b=el(\"wifiBanner\");\n"
    "if(!b)return;\n"
    "b.className=kind?(\"show \"+kind):\"\";\n"
    "b.textContent=text||\"\";\n"
    "}\n"
    "function setCloudBanner(kind,text){\n"
    "var b=el(\"cloudBanner\");\n"
    "if(!b)return;\n"
    "b.className=kind?(\"show \"+kind):\"\";\n"
    "b.textContent=text||\"\";\n"
    "}\n"
    "function drawRadar(j){\n"
    "var c=el(\"radarFan\");if(!c||!c.getContext)return;\n"
    "var ctx=c.getContext(\"2d\");\n"
    "var W=c.width,H=c.height;\n"
    "ctx.clearRect(0,0,W,H);\n"
    "ctx.fillStyle=\"#1a1f2a\";ctx.fillRect(0,0,W,H);\n"
    "/* Apex at top = module; fan opens downward = looking at people. */\n"
    "var cx=W/2,cy=18,R=H-40;\n"
    "var maxDeg=80,maxR=6.0;\n"
    "var t=tr();\n"
    "var a0=(90-maxDeg)*Math.PI/180,a1=(90+maxDeg)*Math.PI/180;\n"
    "ctx.beginPath();\n"
    "ctx.moveTo(cx,cy);\n"
    "ctx.arc(cx,cy,R,a0,a1);\n"
    "ctx.closePath();\n"
    "ctx.fillStyle=\"rgba(90,160,255,0.12)\";ctx.fill();\n"
    "ctx.strokeStyle=\"rgba(160,200,255,0.45)\";ctx.lineWidth=1;ctx.stroke();\n"
    "ctx.fillStyle=\"rgba(200,220,255,0.75)\";ctx.font=\"10px system-ui,sans-serif\";\n"
    "for(var ring=1;ring<=4;ring++){\n"
    "var rr=R*ring/4;\n"
    "ctx.beginPath();\n"
    "ctx.arc(cx,cy,rr,a0,a1);\n"
    "ctx.strokeStyle=\"rgba(160,200,255,0.22)\";ctx.stroke();\n"
    "var label=(maxR*ring/4).toFixed(ring===4?0:1)+\"m\";\n"
    "ctx.fillText(label,cx+6,cy+rr-2);\n"
    "}\n"
    "ctx.strokeStyle=\"rgba(255,255,255,0.35)\";\n"
    "ctx.beginPath();ctx.moveTo(cx,cy);ctx.lineTo(cx,cy+R);ctx.stroke();\n"
    "var panSign=(j&&typeof j.pan_sign===\"number\")?j.pan_sign:1;\n"
    "var pan=(j&&typeof j.pan_deg===\"number\")?j.pan_deg:0;\n"
    "/* Flip L/R for module-looking-at-people view (screen left = person's left). */\n"
    "pan=-pan;\n"
    "var blips=(j&&j.radar&&j.radar.blips)||[];\n"
    "function toXY(azMapped,dist){\n"
    "var a=(90+azMapped)*Math.PI/180;\n"
    "var rr=Math.min(1,Math.max(0,dist/maxR))*R;\n"
    "return[cx+Math.cos(a)*rr,cy+Math.sin(a)*rr];\n"
    "}\n"
    "var nearestIdx=0,nearestR=1e9;\n"
    "for(var i=0;i<blips.length;i++){\n"
    "var rr=blips[i].r||0;\n"
    "if(rr<nearestR){nearestR=rr;nearestIdx=i;}\n"
    "}\n"
    "for(var i=0;i<blips.length;i++){\n"
    "var az=-(panSign*(blips[i].az||0));\n"
    "if(az>maxDeg)az=maxDeg;if(az<-maxDeg)az=-maxDeg;\n"
    "var p=toXY(az,blips[i].r||0);\n"
    "ctx.beginPath();ctx.arc(p[0],p[1],i===nearestIdx?7:4,0,Math.PI*2);\n"
    "ctx.fillStyle=i===nearestIdx?\"#7CFFB2\":\"#6B8CFF\";ctx.fill();\n"
    "if(i===nearestIdx){ctx.strokeStyle=\"#E8FFF2\";ctx.lineWidth=2;ctx.stroke();}\n"
    "}\n"
    "if((!blips.length)&&j&&j.radar&&j.radar.az_ok&&j.radar.dist_m>0){\n"
    "var az0=-(panSign*(j.radar.az||0));\n"
    "if(az0>maxDeg)az0=maxDeg;if(az0<-maxDeg)az0=-maxDeg;\n"
    "var p0=toXY(az0,j.radar.dist_m);\n"
    "ctx.beginPath();ctx.arc(p0[0],p0[1],7,0,Math.PI*2);\n"
    "ctx.fillStyle=\"#7CFFB2\";ctx.fill();\n"
    "}\n"
    "if(pan>maxDeg)pan=maxDeg;if(pan<-maxDeg)pan=-maxDeg;\n"
    "var tip=toXY(pan,maxR*0.92);\n"
    "ctx.strokeStyle=\"#FF9F43\";ctx.lineWidth=3;\n"
    "ctx.beginPath();ctx.moveTo(cx,cy);ctx.lineTo(tip[0],tip[1]);ctx.stroke();\n"
    "ctx.fillStyle=\"#FF9F43\";\n"
    "ctx.beginPath();\n"
    "var ang=(90+pan)*Math.PI/180;\n"
    "ctx.moveTo(tip[0],tip[1]);\n"
    "ctx.lineTo(tip[0]-Math.cos(ang-0.4)*12,tip[1]-Math.sin(ang-0.4)*12);\n"
    "ctx.lineTo(tip[0]-Math.cos(ang+0.4)*12,tip[1]-Math.sin(ang+0.4)*12);\n"
    "ctx.closePath();ctx.fill();\n"
    "ctx.fillStyle=\"#c9d4e6\";ctx.font=\"12px system-ui,sans-serif\";\n"
    "var panShow=(j&&typeof j.pan_deg===\"number\")?j.pan_deg:0;\n"
    "ctx.fillText(\"pan \"+panShow.toFixed(0)+\"°\",8,H-8);\n"
    "var hint=el(\"radarHint\");\n"
    "if(hint){\n"
    "var n=blips.length||((j&&j.radar&&j.radar.count)||0);\n"
    "hint.textContent=n>0?t.radarLive:t.radarEmpty;\n"
    "}\n"
    "var rule=el(\"radarRule\");\n"
    "if(rule)rule.textContent=t.radarRule||\"\";\n"
    "}\n"
    "function paintStatus(j){\n"
    "var t=tr();\n"
    "if(j&&!prefsHydrated){\n"
    "if(j.lang){el(\"langSel\").value=j.lang;}\n"
    "if(j.theme===\"male\"){gender=\"male\";}else if(j.theme===\"female\"){gender=\"female\";}\n"
    "screenFlip=!!j.screen_flip;\n"
    "prefsHydrated=true;\n"
    "applyI18n();\n"
    "}\n"
    "var follow=!!(j&&j.follow);\n"
    "var fb=el(\"fbadge\");\n"
    "if(fb){fb.textContent=follow?t.fOn:t.fOff;fb.className=\"badge \"+(follow?\"on\":\"off\");}\n"
    "el(\"vFollow\").innerHTML='<span class=\"badge '+(follow?\"on\":\"off\")+'\">'+(follow?t.fOn:t.fOff)+'</span>';\n"
    "var present=!!(j&&j.present);\n"
    "if(el(\"vPresent\"))el(\"vPresent\").textContent=present?t.presentYes:t.presentNo;\n"
    "var zone=(j&&j.zone)||\"void\";\n"
    "var zlab=zone===\"near\"?(t.zoneNear||T.en.zoneNear):(zone===\"far\"?(t.zoneFar||T.en.zoneFar):(t.zoneVoid||T.en.zoneVoid));\n"
    "if(el(\"vZone\"))el(\"vZone\").textContent=zlab;\n"
    "var live=el(\"pTuneLive\");\n"
    "if(live){\n"
    "var d=(j&&j.radar&&typeof j.radar.dist_m===\"number\")?j.radar.dist_m:null;\n"
    "var uart=!!(j&&j.radar&&j.radar.uart);\n"
    "live.textContent=zlab+(uart&&d!=null?(\" · \"+d.toFixed(2)+\" m\"):\"\");\n"
    "}\n"
    "if(j&&j.tune&&!tuneHydrated){\n"
    "function setNum(id,v){var e=el(id);if(e&&typeof v===\"number\"&&isFinite(v))e.value=v;}\n"
    "setNum(\"nearM\",j.tune.near_m);setNum(\"nearExitM\",j.tune.near_exit_m);setNum(\"farM\",j.tune.far_m);\n"
    "setNum(\"hideS\",j.tune.hide_s);setNum(\"riseMs\",j.tune.rise_ms);setNum(\"panDps\",j.tune.pan_dps);setNum(\"panMax\",j.tune.pan_max);\n"
    "tuneHydrated=true;\n"
    "}\n"
    "drawRadar(j||{});\n"
    "var sta=(j&&j.wifi&&j.wifi.sta)||\"down\";\n"
    "var ssid=(j&&j.wifi&&j.wifi.ssid)||\"\";\n"
    "var ip=(j&&j.wifi&&j.wifi.ip)||\"\";\n"
    "var rssi=(j&&j.wifi&&typeof j.wifi.rssi===\"number\")?j.wifi.rssi:-127;\n"
    "var reason=(j&&j.wifi&&j.wifi.reason)||0;\n"
    "var retry=(j&&j.wifi&&j.wifi.retry)||0;\n"
    "if(sta===\"ok\"){\n"
    "el(\"vHomeWifi\").innerHTML='<span class=\"badge ok\">'+t.connOk+'</span> '+(ssid||\"\")+(ip?(\" · \"+ip):\"\")+rssiBars(rssi);\n"
    "setBanner(\"ok\",t.connOk+(ssid?(\" · \"+ssid):\"\")+(ip?(\" · \"+ip):\"\"));\n"
    "wifiBusy=false;if(el(\"btnWifi\"))el(\"btnWifi\").disabled=false;\n"
    "}else if(sta===\"connecting\"){\n"
    "el(\"vHomeWifi\").innerHTML='<span class=\"badge wait\">'+t.wifiWait+'</span> '+(ssid||\"\")+(retry?(\" · #\"+retry):\"\");\n"
    "setBanner(\"wait\",t.connecting+(ssid?(\" · \"+ssid):\"\")+(retry?(\" · retry \"+retry):\"\"));\n"
    "}else if(sta===\"fail\"){\n"
    "el(\"vHomeWifi\").innerHTML='<span class=\"badge bad\">'+t.connFail+'</span>';\n"
    "setBanner(\"bad\",t.connFail+(reason?(\" (code \"+reason+\")\"):\"\"));\n"
    "wifiBusy=false;if(el(\"btnWifi\"))el(\"btnWifi\").disabled=false;\n"
    "}else{\n"
    "el(\"vHomeWifi\").innerHTML='<span class=\"badge off\">'+t.wifiDown+'</span>';\n"
    "if(!(lastSta===\"connecting\"||lastSta===\"ok\")&&el(\"wifiBanner\")&&!el(\"wifiBanner\").className){setBanner(\"\",\"\");}\n"
    "}\n"
    "lastSta=sta;\n"
    "if(window.paintExtra)window.paintExtra(j,sta);\n"
    "var th=(j&&j.theme)===\"male\"?t.blue:t.pink;\n"
    "el(\"vTheme\").textContent=th;\n"
    "var cloud=j&&j.cloud;\n"
    "if(cloud&&!cloudHydrated){\n"
    "if(el(\"bindCode\")&&cloud.bind)el(\"bindCode\").value=cloud.bind;\n"
    "if(el(\"claimBase\")&&cloud.claim_base)el(\"claimBase\").value=cloud.claim_base;\n"
    "cloudHydrated=true;\n"
    "}\n"
    "if(el(\"vCloud\")){\n"
    "var ms=cloud&&cloud.mqtt?cloud.mqtt:\"idle\";\n"
    "var badge=\"off\";\n"
    "if(ms===\"up\")badge=\"ok\";\n"
    "else if(ms===\"claim\"||ms===\"mqtt\"||ms===\"sntp\"||ms===\"wait_ip\")badge=\"wait\";\n"
    "else if(ms===\"err\")badge=\"bad\";\n"
    "var extra=\"\";\n"
    "if(cloud&&cloud.claimed&&cloud.device_id)extra=\" · \"+cloud.device_id;\n"
    "if(cloud&&cloud.err)extra+=\" · \"+cloud.err;\n"
    "el(\"vCloud\").innerHTML='<span class=\"badge '+badge+'\">'+ms+\"</span>\"+extra;\n"
    "var step=t.cloudStart;\n"
    "if(ms===\"wait_ip\")step=(sta!==\"ok\")?(t.cloudNeedWifi||t.cloudWaitIp):t.cloudWaitIp;\n"
    "else if(ms===\"sntp\")step=t.cloudSntp||step;\n"
    "else if(ms===\"claim\")step=t.cloudClaim||step;\n"
    "else if(ms===\"mqtt\")step=t.cloudMqtt||step;\n"
    "else if(ms===\"err\")step=(t.cloudFail||t.connFail)+(cloud&&cloud.err?(\" · \"+cloud.err):\"\");\n"
    "else if(ms===\"up\")step=t.cloudOk||t.connOk;\n"
    "else if(ms===\"idle\")step=\"\";\n"
    "if(ms===\"up\"){cloudBusy=false;if(el(\"btnCloud\"))el(\"btnCloud\").disabled=false;setCloudBanner(\"ok\",step);}\n"
    "else if(ms===\"err\"){cloudBusy=false;if(el(\"btnCloud\"))el(\"btnCloud\").disabled=false;setCloudBanner(\"bad\",step);}\n"
    "else if(ms===\"wait_ip\"&&sta!==\"ok\"){cloudBusy=false;if(el(\"btnCloud\"))el(\"btnCloud\").disabled=false;setCloudBanner(\"wait\",step);}\n"
    "else if(step){setCloudBanner(\"wait\",step+(cloud&&cloud.err?(\" · \"+cloud.err):\"\"));}\n"
    "}\n"
    "}\n"
    "function refresh(){\n"
    "var x=new XMLHttpRequest();\n"
    "x.open(\"GET\",\"/api/status\",true);x.timeout=3000;\n"
    "x.onload=function(){\n"
    "try{paintStatus(JSON.parse(x.responseText||\"{}\"));}catch(e){}\n"
    "};\n"
    "try{x.send();}catch(e){}\n"
    "}\n"
    "function j(u){var x=new XMLHttpRequest();x.open(\"GET\",u,true);x.timeout=3000;x.onload=refresh;try{x.send();}catch(e){}}\n"
    "function setFollow(v){var x=new XMLHttpRequest();x.open(\"GET\",\"/api/follow?on=\"+v,true);x.timeout=3000;x.onload=refresh;try{x.send();}catch(e){}}\n"
    "el(\"btnOn\").onclick=function(){setFollow(1);};\n"
    "el(\"btnOff\").onclick=function(){setFollow(0);};\n"
    "el(\"btnTune\").onclick=function(){\n"
    "var t=tr();\n"
    "var banner=el(\"tuneBanner\");\n"
    "function show(cls,msg){if(!banner)return;banner.className=\"show \"+cls;banner.textContent=msg;}\n"
    "var body=\"near_m=\"+encodeURIComponent(el(\"nearM\").value)\n"
    "+\"&near_exit_m=\"+encodeURIComponent(el(\"nearExitM\").value)\n"
    "+\"&far_m=\"+encodeURIComponent(el(\"farM\").value)\n"
    "+\"&hide_s=\"+encodeURIComponent(el(\"hideS\").value)\n"
    "+\"&rise_ms=\"+encodeURIComponent(el(\"riseMs\").value)\n"
    "+\"&pan_dps=\"+encodeURIComponent(el(\"panDps\").value)\n"
    "+\"&pan_max=\"+encodeURIComponent(el(\"panMax\").value);\n"
    "var x=new XMLHttpRequest();\n"
    "x.open(\"POST\",\"/api/tune\",true);x.timeout=4000;\n"
    "x.setRequestHeader(\"Content-Type\",\"application/x-www-form-urlencoded\");\n"
    "x.onload=function(){\n"
    "var ok=x.status>=200&&x.status<300;\n"
    "show(ok?\"ok\":\"bad\",ok?(t.tuneOk||T.en.tuneOk):(t.tuneFail||T.en.tuneFail));\n"
    "tuneHydrated=false;refresh();\n"
    "};\n"
    "x.onerror=x.ontimeout=function(){show(\"bad\",t.tuneFail||T.en.tuneFail);};\n"
    "try{x.send(body);}catch(e){show(\"bad\",t.tuneFail||T.en.tuneFail);}\n"
    "};\n"
    "el(\"btnDefaults\").onclick=function(){\n"
    "var t=tr();\n"
    "var banner=el(\"tuneBanner\");\n"
    "function show(cls,msg){if(!banner)return;banner.className=\"show \"+cls;banner.textContent=msg;}\n"
    "var x=new XMLHttpRequest();\n"
    "x.open(\"POST\",\"/api/defaults\",true);x.timeout=4000;\n"
    "x.onload=function(){\n"
    "var ok=x.status>=200&&x.status<300;\n"
    "show(ok?\"ok\":\"bad\",ok?(t.resetOk||T.en.resetOk):(t.resetFail||T.en.resetFail));\n"
    "tuneHydrated=false;refresh();\n"
    "};\n"
    "x.onerror=x.ontimeout=function(){show(\"bad\",t.resetFail||T.en.resetFail);};\n"
    "try{x.send();}catch(e){show(\"bad\",t.resetFail||T.en.resetFail);}\n"
    "};\n"
    "document.querySelectorAll(\"[data-j]\").forEach(function(b){b.onclick=function(){j(b.getAttribute(\"data-j\"));};});\n"
    "function currentSsid(){\n"
    "return ((el(\"ssidManual\")&&el(\"ssidManual\").value||\"\").trim()||(el(\"ssidList\")&&el(\"ssidList\").value||\"\")).trim();\n"
    "}\n"
    "function fillSsidList(nets,keep){\n"
    "var list=el(\"ssidList\");if(!list)return;\n"
    "var sel=keep||list.value||\"\";\n"
    "list.innerHTML=\"\";\n"
    "if(!nets||!nets.length){list.innerHTML='<option value=\"\">—</option>';return;}\n"
    "nets.forEach(function(n){\n"
    "var o=document.createElement(\"option\");\n"
    "o.value=n.ssid;\n"
    "o.textContent=n.ssid+\"  (\"+n.rssi+\" dBm)\";\n"
    "list.appendChild(o);\n"
    "});\n"
    "if(sel){\n"
    "var found=false;\n"
    "for(var i=0;i<list.options.length;i++){\n"
    "if(list.options[i].value===sel){list.selectedIndex=i;found=true;break;}\n"
    "}\n"
    "if(!found){\n"
    "var o=document.createElement(\"option\");\n"
    "o.value=sel;o.textContent=sel;\n"
    "list.insertBefore(o,list.firstChild);\n"
    "list.value=sel;\n"
    "}\n"
    "}\n"
    "}\n"
    "function ssidListBusy(){\n"
    "var list=el(\"ssidList\");\n"
    "var pass=el(\"wifiPass\");\n"
    "return (list&&document.activeElement===list)||(pass&&document.activeElement===pass);\n"
    "}\n"
    "function scanWifi(opts){\n"
    "var silent=opts&&opts.silent;\n"
    "var force=opts&&opts.force;\n"
    "if(!force&&(scanning||wifiBusy))return;\n"
    "if(silent&&(ssidListBusy()||lastSta===\"connecting\"))return;\n"
    "if(force)scanning=false;\n"
    "scanning=true;\n"
    "var t=tr();var list=el(\"ssidList\");\n"
    "var keep=currentSsid();\n"
    "if(!silent&&list)list.innerHTML='<option value=\"\">'+t.scanning+\"</option>\";\n"
    "var x=new XMLHttpRequest();\n"
    "x.open(\"GET\",force?\"/api/wifi/scan?force=1\":\"/api/wifi/scan\",true);x.timeout=15000;\n"
    "x.onload=function(){\n"
    "scanning=false;\n"
    "try{\n"
    "var j=JSON.parse(x.responseText||\"{}\");\n"
    "fillSsidList(j.networks,keep);\n"
    "}catch(e){if(!silent&&list)list.innerHTML='<option value=\"\">'+t.scanFail+\"</option>\";}\n"
    "};\n"
    "x.onerror=x.ontimeout=function(){scanning=false;if(!silent&&list)list.innerHTML='<option value=\"\">'+t.scanFail+\"</option>\";};\n"
    "try{x.send();}catch(e){scanning=false;if(!silent&&list)list.innerHTML='<option value=\"\">'+t.scanFail+\"</option>\";}\n"
    "}\n"
    "function startAutoScan(){\n"
    "if(scanTimer)return;\n"
    "scanTimer=setInterval(function(){scanWifi({silent:true});},8000);\n"
    "}\n"
    "el(\"btnScan\").onclick=function(){scanWifi({force:true});};\n"
    "el(\"btnWifi\").onclick=function(){\n"
    "var t=tr();\n"
    "var ssid=currentSsid();\n"
    "if(!ssid){setBanner(\"bad\",t.needSsid);return;}\n"
    "wifiBusy=true;\n"
    "setBanner(\"wait\",t.connStart);el(\"btnWifi\").disabled=true;\n"
    "var body=\"ssid=\"+encodeURIComponent(ssid)+\"&pass=\"+encodeURIComponent(el(\"wifiPass\").value);\n"
    "var x=new XMLHttpRequest();\n"
    "x.open(\"POST\",\"/api/wifi/connect\",true);x.timeout=20000;\n"
    "x.setRequestHeader(\"Content-Type\",\"application/x-www-form-urlencoded\");\n"
    "x.onload=function(){\n"
    "if(x.status<200||x.status>=300){setBanner(\"bad\",t.connFail);wifiBusy=false;el(\"btnWifi\").disabled=false;}\n"
    "else{setBanner(\"wait\",t.connecting+\" · \"+ssid);lastSta=\"connecting\";}\n"
    "refresh();\n"
    "};\n"
    "x.onerror=x.ontimeout=function(){setBanner(\"bad\",t.connFail);wifiBusy=false;el(\"btnWifi\").disabled=false;};\n"
    "try{x.send(body);}catch(e){setBanner(\"bad\",t.connFail);wifiBusy=false;el(\"btnWifi\").disabled=false;}\n"
    "};\n"
    "el(\"btnCloud\").onclick=function(){\n"
    "var t=tr();\n"
    "var bind=(el(\"bindCode\")&&el(\"bindCode\").value||\"\").trim();\n"
    "if(!bind){setCloudBanner(\"bad\",t.needBind||\"Enter a pair code\");return;}\n"
    "var claim=(el(\"claimBase\")&&el(\"claimBase\").value||\"\").trim();\n"
    "if(!/^https?:\\/\\//.test(claim)){setCloudBanner(\"bad\",t.needUrl||T.en.needUrl);return;}\n"
    "cloudBusy=true;\n"
    "setCloudBanner(\"wait\",t.cloudStart||t.connStart);el(\"btnCloud\").disabled=true;\n"
    "var body=\"bind=\"+encodeURIComponent(bind)+\"&claim_base=\"+encodeURIComponent(claim);\n"
    "var x=new XMLHttpRequest();\n"
    "x.open(\"POST\",\"/api/cloud/connect\",true);x.timeout=20000;\n"
    "x.setRequestHeader(\"Content-Type\",\"application/x-www-form-urlencoded\");\n"
    "x.onload=function(){\n"
    "if(x.status<200||x.status>=300){setCloudBanner(\"bad\",(t.cloudFail||t.connFail)+\" · \"+(x.responseText||x.status));cloudBusy=false;el(\"btnCloud\").disabled=false;}\n"
    "else{setCloudBanner(\"wait\",t.cloudStart||t.connecting);}\n"
    "refresh();\n"
    "};\n"
    "x.onerror=x.ontimeout=function(){setCloudBanner(\"bad\",t.cloudFail||t.connFail);cloudBusy=false;el(\"btnCloud\").disabled=false;};\n"
    "try{x.send(body);}catch(e){setCloudBanner(\"bad\",t.cloudFail||t.connFail);cloudBusy=false;el(\"btnCloud\").disabled=false;}\n"
    "};\n"
    "function banner(id,cls,msg){var b=el(id);if(!b)return;b.className=msg?(\"banner show \"+cls):\"banner\";b.textContent=msg||\"\";}\n"
    "function L(k){var t=tr();return t[k]||T.en[k]||\"\";}\n"
    "var placeHydrated=false,cityPending=false;\n"
    "window.paintExtra=function(j,sta){\n"
    "var p=j&&j.place;\n"
    "if(p){\n"
    "if(!placeHydrated&&el(\"cityIn\")){el(\"cityIn\").value=p.city||\"\";placeHydrated=true;}\n"
    "var v=p.ok?(p.name||p.city):(p.city?(p.city+\" …\"):\"—\");\n"
    "el(\"vPlace\").textContent=v;\n"
    "if(cityPending){\n"
    "if(p.ok){banner(\"placeBanner\",\"ok\",L(\"cityOk\")+\" \"+(p.name||p.city));cityPending=false;}\n"
    "else if(p.err===\"city_not_found\"){banner(\"placeBanner\",\"bad\",L(\"cityNotFound\"));cityPending=false;}\n"
    "else if(sta!==\"ok\"){banner(\"placeBanner\",\"wait\",L(\"cityNeedWifi\"));}\n"
    "}\n"
    "}\n"
    "var g=j&&j.telegram;\n"
    "if(g){\n"
    "var st=g.state,txt=L(\"tgOff\"),cls=\"off\";\n"
    "if(st===\"paired\"){txt=L(\"tgPaired\")+(g.bot?(\" · @\"+g.bot):\"\");cls=\"ok\";}\n"
    "else if(st===\"wait_pair\"){txt=L(\"tgWaitPair\")+(g.bot?(\" t.me/\"+g.bot):\"\");cls=\"wait\";}\n"
    "else if(st===\"wait_wifi\"){txt=L(\"tgWaitWifi\");cls=\"wait\";}\n"
    "else if(st===\"bad_token\"){txt=L(\"tgBad\");cls=\"bad\";}\n"
    "else if(st===\"err\"){txt=L(\"tgErr\");cls=\"bad\";}\n"
    "el(\"vTg\").innerHTML='<span class=\"badge '+cls+'\">'+(st||\"off\")+\"</span> \";\n"
    "el(\"vTg\").appendChild(document.createTextNode(txt));\n"
    "if(g.token_set||st!==\"off\"){banner(\"tgBanner\",cls===\"off\"?\"wait\":cls,txt);}\n"
    "if(el(\"btnTgUnpair\"))el(\"btnTgUnpair\").disabled=!g.paired;\n"
    "}\n"
    "};\n"
    "function post(url,body,cb){var x=new XMLHttpRequest();x.open(\"POST\",url,true);x.timeout=6000;\n"
    "x.setRequestHeader(\"Content-Type\",\"application/x-www-form-urlencoded\");\n"
    "x.onload=function(){cb(x.status>=200&&x.status<300,x.responseText);refresh();};\n"
    "x.onerror=x.ontimeout=function(){cb(false,\"\");};try{x.send(body);}catch(e){cb(false,\"\");}}\n"
    "el(\"btnCity\").onclick=function(){\n"
    "var c=(el(\"cityIn\").value||\"\").trim();\n"
    "var off=-new Date().getTimezoneOffset();\n"
    "cityPending=true;banner(\"placeBanner\",\"wait\",L(\"cityStart\"));\n"
    "post(\"/api/place\",\"city=\"+encodeURIComponent(c)+\"&utc_off=\"+off,function(ok,txt){if(!ok){cityPending=false;banner(\"placeBanner\",\"bad\",txt||\"error\");}});\n"
    "};\n"
    "el(\"btnTg\").onclick=function(){\n"
    "var tok=(el(\"tgToken\").value||\"\").trim();\n"
    "post(\"/api/telegram\",\"token=\"+encodeURIComponent(tok),function(ok,txt){banner(\"tgBanner\",ok?\"wait\":\"bad\",ok?L(\"tgWaitWifi\"):(txt||\"error\"));if(ok)el(\"tgToken\").value=\"\";});\n"
    "};\n"
    "el(\"btnTgUnpair\").onclick=function(){post(\"/api/telegram\",\"unpair=1\",function(){});};\n"
    "applyI18n();\n"
    "if(lsGet(\"pet_setup\")===\"1\"){showMain();}else{showWelcome();}\n"
    "refresh();\n"
    "setInterval(refresh,700);\n"
    "})();\n"
    "</script>\n"
    "</body>\n"
    "</html>\n"
    "\n"
;
